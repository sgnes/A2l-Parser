ASAP2_VERSION 1 70
/begin PROJECT TestProject ""
/* File automatically generated by Hexwork */
/* don't edit it manually ! */
/begin HEADER "" VERSION "1" PROJECT_NO No /end HEADER
/begin MODULE CPP ""
/begin IF_DATA XCPplus 0x0105
 /begin PROTOCOL_LAYER 0x0105 0x0100 0x0500 0x0100 0x0300 0x0100 0x0100 0xFA 0x40 0x40 BYTE_ORDER_MSB_LAST ADDRESS_GRANULARITY_BYTE OPTIONAL_CMD GET_DAQ_EVENT_INFO OPTIONAL_CMD SET_REQUEST OPTIONAL_CMD GET_DAQ_RESOLUTION_INFO OPTIONAL_CMD GET_DAQ_PROCESSOR_INFO OPTIONAL_CMD GET_DAQ_CLOCK OPTIONAL_CMD START_STOP_SYNCH OPTIONAL_CMD START_STOP_DAQ_LIST OPTIONAL_CMD GET_DAQ_LIST_MODE OPTIONAL_CMD SET_DAQ_LIST_MODE OPTIONAL_CMD SET_CAL_PAGE OPTIONAL_CMD GET_CAL_PAGE OPTIONAL_CMD WRITE_DAQ OPTIONAL_CMD SET_DAQ_PTR OPTIONAL_CMD ALLOC_ODT_ENTRY OPTIONAL_CMD ALLOC_ODT OPTIONAL_CMD ALLOC_DAQ OPTIONAL_CMD FREE_DAQ OPTIONAL_CMD DOWNLOAD_NEXT OPTIONAL_CMD BUILD_CHECKSUM OPTIONAL_CMD DOWNLOAD_MAX OPTIONAL_CMD SET_MTA OPTIONAL_CMD UPLOAD OPTIONAL_CMD COPY_CAL_PAGE COMMUNICATION_MODE_SUPPORTED BLOCK SLAVE MASTER 0x04 0x64 /end PROTOCOL_LAYER
 /begin DAQ DYNAMIC 0x03 0x03 0x00 OPTIMISATION_TYPE_DEFAULT ADDRESS_EXTENSION_FREE IDENTIFICATION_FIELD_TYPE_ABSOLUTE GRANULARITY_ODT_ENTRY_SIZE_DAQ_BYTE 0x64 OVERLOAD_INDICATION_EVENT
  /begin DAQ_MEMORY_CONSUMPTION 0x000032c5 0x0030 0x0010 0x0005 0x0001 0x0002 /begin BUFFER_RESERVE 20 40 /end BUFFER_RESERVE /end DAQ_MEMORY_CONSUMPTION
  /begin STIM GRANULARITY_ODT_ENTRY_SIZE_STIM_WORD 0x00 BIT_STIM_SUPPORTED /end STIM
  /begin EVENT "XcpEventChannel_1ms" "XEvC1ms" 0x02 DAQ 0x01 0x01 0x06 0x00 /end EVENT
  /begin EVENT "XcpEventChannel_10ms" "XEvC10ms" 0x00 DAQ 0x01 0x0A 0x06 0x00 /end EVENT
  /begin EVENT "XcpEventChannel_100ms" "XEvC100ms" 0x01 DAQ 0x01 0x64 0x06 0x00 /end EVENT
 /end DAQ
 /begin XCP_ON_CAN 0x0105 CAN_ID_BROADCAST 0x00 CAN_ID_MASTER 0xDBFFE600 CAN_ID_SLAVE 0xDBFFE601 BAUDRATE 500000 SAMPLE_POINT 80 SAMPLE_RATE SINGLE BTL_CYCLES 80 SJW 16 SYNC_EDGE SINGLE
  /begin CAN_FD MAX_DLC 64 CAN_FD_DATA_TRANSFER_BAUDRATE 2000000 SAMPLE_POINT 80 BTL_CYCLES 20 SJW 4 SYNC_EDGE SINGLE MAX_DLC_REQUIRED SECONDARY_SAMPLE_POINT 80 TRANSCEIVER_DELAY_COMPENSATION ON /end CAN_FD
 /end XCP_ON_CAN
/end IF_DATA
/begin MOD_PAR ""
 /begin MEMORY_SEGMENT PF1_APPL_SWID "PF1_APPL_SWID" RESERVED FLASH INTERN 0xb0440040 0x200 -1 -1 -1 -1 -1
  /begin IF_DATA XCPplus 0x0105
   /begin SEGMENT 0x00 0x01 0x00 0x00 0x00 /begin CHECKSUM XCP_CRC_16_CITT /end CHECKSUM
    /begin PAGE 0x00 ECU_ACCESS_DONT_CARE XCP_READ_ACCESS_WITH_ECU_ONLY XCP_WRITE_ACCESS_NOT_ALLOWED /end PAGE
   /end SEGMENT
  /end IF_DATA
 /end MEMORY_SEGMENT
 /begin MEMORY_SEGMENT PF1_CALIB_SWID "PF1_CALIB_SWID" RESERVED FLASH INTERN 0xb05FC040 0x200 -1 -1 -1 -1 -1
  /begin IF_DATA XCPplus 0x0105
   /begin SEGMENT 0x01 0x01 0x00 0x00 0x00 /begin CHECKSUM XCP_CRC_16_CITT /end CHECKSUM
    /begin PAGE 0x00 ECU_ACCESS_DONT_CARE XCP_READ_ACCESS_WITH_ECU_ONLY XCP_WRITE_ACCESS_NOT_ALLOWED /end PAGE
   /end SEGMENT
  /end IF_DATA
 /end MEMORY_SEGMENT
 /begin MEMORY_SEGMENT PF1_APPL_SW_BLOCK "PF1_APPL_SW_BLOCK" OFFLINE_DATA ROM INTERN 0xb0440000 0x40 -1 -1 -1 -1 -1
  /begin IF_DATA XCPplus 0x0105
   /begin SEGMENT 0x04 0x02 0x00 0x00 0x00 /begin CHECKSUM XCP_CRC_16_CITT /end CHECKSUM
    /begin PAGE 0x00 ECU_ACCESS_DONT_CARE XCP_READ_ACCESS_WITH_ECU_ONLY XCP_WRITE_ACCESS_NOT_ALLOWED /end PAGE
    /begin PAGE 0x01 ECU_ACCESS_WITH_XCP_ONLY XCP_READ_ACCESS_WITH_ECU_ONLY XCP_WRITE_ACCESS_NOT_ALLOWED /end PAGE
   /end SEGMENT
  /end IF_DATA
 /end MEMORY_SEGMENT
 /begin MEMORY_SEGMENT PF1_OFFLINE_CALIB "PF1_OFFLINE_CALIB" OFFLINE_DATA ROM INTERN 0xb0560000 0xb8000 -1 -1 -1 -1 -1
  /begin IF_DATA XCPplus 0x0105
   /begin SEGMENT 0x04 0x02 0x00 0x00 0x00 /begin CHECKSUM XCP_CRC_16_CITT /end CHECKSUM
    /begin PAGE 0x00 ECU_ACCESS_DONT_CARE XCP_READ_ACCESS_WITH_ECU_ONLY XCP_WRITE_ACCESS_NOT_ALLOWED /end PAGE
    /begin PAGE 0x01 ECU_ACCESS_WITH_XCP_ONLY XCP_READ_ACCESS_WITH_ECU_ONLY XCP_WRITE_ACCESS_NOT_ALLOWED /end PAGE
   /end SEGMENT
  /end IF_DATA
 /end MEMORY_SEGMENT
 /begin MEMORY_SEGMENT PF1_LOGISTIC_OFFLINE_CALIB "PF1_LOGISTIC_OFFLINE_CALIB" OFFLINE_DATA ROM INTERN 0xb05F8000 0x4040 -1 -1 -1 -1 -1
  /begin IF_DATA XCPplus 0x0105
   /begin SEGMENT 0x04 0x02 0x00 0x00 0x00 /begin CHECKSUM XCP_CRC_16_CITT /end CHECKSUM
    /begin PAGE 0x00 ECU_ACCESS_DONT_CARE XCP_READ_ACCESS_WITH_ECU_ONLY XCP_WRITE_ACCESS_NOT_ALLOWED /end PAGE
    /begin PAGE 0x01 ECU_ACCESS_WITH_XCP_ONLY XCP_READ_ACCESS_WITH_ECU_ONLY XCP_WRITE_ACCESS_NOT_ALLOWED /end PAGE
   /end SEGMENT
  /end IF_DATA
 /end MEMORY_SEGMENT
 /begin MEMORY_SEGMENT PF1_ONLINE_CALIB "PF1_ONLINE_CALIB" DATA FLASH INTERN 0xb0500000 0x60000 -1 -1 -1 -1 -1
  /begin IF_DATA XCPplus 0x0105
   /begin SEGMENT 0x05 0x02 0x00 0x00 0x00 /begin CHECKSUM XCP_CRC_16_CITT /end CHECKSUM
    /begin PAGE 0x00 ECU_ACCESS_DONT_CARE XCP_READ_ACCESS_WITH_ECU_ONLY XCP_WRITE_ACCESS_NOT_ALLOWED /end PAGE
    /begin PAGE 0x01 ECU_ACCESS_WITH_XCP_ONLY XCP_READ_ACCESS_WITH_ECU_ONLY XCP_WRITE_ACCESS_WITH_ECU_ONLY /end PAGE
   /end SEGMENT
  /end IF_DATA
 /end MEMORY_SEGMENT
 /begin MEMORY_SEGMENT PF0_ASW_CODE_FAST_ASIL_C0 "PF0_ASW_CODE_FAST_ASIL_C0" CODE FLASH INTERN 0xb00F8000 0xD000 -1 -1 -1 -1 -1
  /begin IF_DATA XCPplus 0x0105
   /begin SEGMENT 0x0C 0x01 0x00 0x00 0x00 /begin CHECKSUM XCP_CRC_16_CITT /end CHECKSUM
    /begin PAGE 0x00 ECU_ACCESS_DONT_CARE XCP_READ_ACCESS_WITH_ECU_ONLY XCP_WRITE_ACCESS_NOT_ALLOWED /end PAGE
   /end SEGMENT
  /end IF_DATA
 /end MEMORY_SEGMENT
 /begin MEMORY_SEGMENT PF0_BSW_CODE_FAST_ASIL_C0 "PF0_BSW_CODE_FAST_ASIL_C0" CODE FLASH INTERN 0xb011C000 0x1800 -1 -1 -1 -1 -1
  /begin IF_DATA XCPplus 0x0105
   /begin SEGMENT 0x0C 0x01 0x00 0x00 0x00 /begin CHECKSUM XCP_CRC_16_CITT /end CHECKSUM
    /begin PAGE 0x00 ECU_ACCESS_DONT_CARE XCP_READ_ACCESS_WITH_ECU_ONLY XCP_WRITE_ACCESS_NOT_ALLOWED /end PAGE
   /end SEGMENT
  /end IF_DATA
 /end MEMORY_SEGMENT
 /begin MEMORY_SEGMENT PF0_BSW_CODE_FAST_QM_C0 "PF0_BSW_CODE_FAST_QM_C0" CODE FLASH INTERN 0xb01B4000 0xb00 -1 -1 -1 -1 -1
  /begin IF_DATA XCPplus 0x0105
   /begin SEGMENT 0x0D 0x01 0x00 0x00 0x00 /begin CHECKSUM XCP_CRC_16_CITT /end CHECKSUM
    /begin PAGE 0x00 ECU_ACCESS_DONT_CARE XCP_READ_ACCESS_WITH_ECU_ONLY XCP_WRITE_ACCESS_NOT_ALLOWED /end PAGE
   /end SEGMENT
  /end IF_DATA
 /end MEMORY_SEGMENT
 /begin MEMORY_SEGMENT PF0_XX_CODE_FAST_QM_C0 "PF0_XX_CODE_FAST_QM_C0" CODE FLASH INTERN 0xb0264000 0x1000 -1 -1 -1 -1 -1
  /begin IF_DATA XCPplus 0x0105
   /begin SEGMENT 0x0E 0x01 0x00 0x00 0x00 /begin CHECKSUM XCP_CRC_16_CITT /end CHECKSUM
    /begin PAGE 0x00 ECU_ACCESS_DONT_CARE XCP_READ_ACCESS_WITH_ECU_ONLY XCP_WRITE_ACCESS_NOT_ALLOWED /end PAGE
   /end SEGMENT
  /end IF_DATA
 /end MEMORY_SEGMENT
 /begin MEMORY_SEGMENT PF1_BSW_CODE_FAST_QM_C1 "PF1_BSW_CODE_FAST_QM_C1" CODE FLASH INTERN 0xb0300000 0x400 -1 -1 -1 -1 -1
  /begin IF_DATA XCPplus 0x0105
   /begin SEGMENT 0x0F 0x01 0x00 0x00 0x00 /begin CHECKSUM XCP_CRC_16_CITT /end CHECKSUM
    /begin PAGE 0x00 ECU_ACCESS_DONT_CARE XCP_READ_ACCESS_WITH_ECU_ONLY XCP_WRITE_ACCESS_NOT_ALLOWED /end PAGE
   /end SEGMENT
  /end IF_DATA
 /end MEMORY_SEGMENT
 /begin MEMORY_SEGMENT PF1_BSW_CODE_FAST_ASIL_C1 "PF1_BSW_CODE_FAST_ASIL_C1" CODE FLASH INTERN 0xb030CA00 0x9400 -1 -1 -1 -1 -1
  /begin IF_DATA XCPplus 0x0105
   /begin SEGMENT 0x10 0x01 0x00 0x00 0x00 /begin CHECKSUM XCP_CRC_16_CITT /end CHECKSUM
    /begin PAGE 0x00 ECU_ACCESS_DONT_CARE XCP_READ_ACCESS_WITH_ECU_ONLY XCP_WRITE_ACCESS_NOT_ALLOWED /end PAGE
   /end SEGMENT
  /end IF_DATA
 /end MEMORY_SEGMENT
 /begin MEMORY_SEGMENT PF1_XX_CODE_FAST_QM_C1 "PF1_XX_CODE_FAST_QM_C1" CODE FLASH INTERN 0xb0348000 0xA000 -1 -1 -1 -1 -1
  /begin IF_DATA XCPplus 0x0105
   /begin SEGMENT 0x11 0x01 0x00 0x00 0x00 /begin CHECKSUM XCP_CRC_16_CITT /end CHECKSUM
    /begin PAGE 0x00 ECU_ACCESS_DONT_CARE XCP_READ_ACCESS_WITH_ECU_ONLY XCP_WRITE_ACCESS_NOT_ALLOWED /end PAGE
   /end SEGMENT
  /end IF_DATA
 /end MEMORY_SEGMENT
 /begin MEMORY_SEGMENT PF1_XX_CODE_FAST_QM_C2 "PF1_XX_CODE_FAST_QM_C2" CODE FLASH INTERN 0xb0380000 0xF000 -1 -1 -1 -1 -1
  /begin IF_DATA XCPplus 0x0105
   /begin SEGMENT 0x12 0x01 0x00 0x00 0x00 /begin CHECKSUM XCP_CRC_16_CITT /end CHECKSUM
    /begin PAGE 0x00 ECU_ACCESS_DONT_CARE XCP_READ_ACCESS_WITH_ECU_ONLY XCP_WRITE_ACCESS_NOT_ALLOWED /end PAGE
   /end SEGMENT
  /end IF_DATA
 /end MEMORY_SEGMENT
 /begin MEMORY_SEGMENT PF1_BSW_CODE_FAST_QM_C2 "PF1_BSW_CODE_FAST_QM_C2" CODE FLASH INTERN 0xb03A3000 0x1000 -1 -1 -1 -1 -1
  /begin IF_DATA XCPplus 0x0105
   /begin SEGMENT 0x13 0x01 0x00 0x00 0x00 /begin CHECKSUM XCP_CRC_16_CITT /end CHECKSUM
    /begin PAGE 0x00 ECU_ACCESS_DONT_CARE XCP_READ_ACCESS_WITH_ECU_ONLY XCP_WRITE_ACCESS_NOT_ALLOWED /end PAGE
   /end SEGMENT
  /end IF_DATA
 /end MEMORY_SEGMENT
 /begin MEMORY_SEGMENT PF1_BSW_CODE_FAST_QM_C3 "PF1_BSW_CODE_FAST_QM_C3" CODE FLASH INTERN 0xb03B8000 0x2000 -1 -1 -1 -1 -1
  /begin IF_DATA XCPplus 0x0105
   /begin SEGMENT 0x14 0x01 0x00 0x00 0x00 /begin CHECKSUM XCP_CRC_16_CITT /end CHECKSUM
    /begin PAGE 0x00 ECU_ACCESS_DONT_CARE XCP_READ_ACCESS_WITH_ECU_ONLY XCP_WRITE_ACCESS_NOT_ALLOWED /end PAGE
   /end SEGMENT
  /end IF_DATA
 /end MEMORY_SEGMENT
 /begin MEMORY_SEGMENT PF1_ASW_CODE_FAST_QM_C3 "PF1_ASW_CODE_FAST_QM_C3" CODE FLASH INTERN 0xb03C2000 0xE000 -1 -1 -1 -1 -1
  /begin IF_DATA XCPplus 0x0105
   /begin SEGMENT 0x15 0x01 0x00 0x00 0x00 /begin CHECKSUM XCP_CRC_16_CITT /end CHECKSUM
    /begin PAGE 0x00 ECU_ACCESS_DONT_CARE XCP_READ_ACCESS_WITH_ECU_ONLY XCP_WRITE_ACCESS_NOT_ALLOWED /end PAGE
   /end SEGMENT
  /end IF_DATA
 /end MEMORY_SEGMENT
 /begin MEMORY_SEGMENT PF1_XX_CODE_FAST_ASIL_C1 "PF1_XX_CODE_FAST_ASIL_C1" CODE FLASH INTERN 0xb032E400 0x6800 -1 -1 -1 -1 -1
  /begin IF_DATA XCPplus 0x0105
   /begin SEGMENT 0x16 0x01 0x00 0x00 0x00 /begin CHECKSUM XCP_CRC_16_CITT /end CHECKSUM
    /begin PAGE 0x00 ECU_ACCESS_DONT_CARE XCP_READ_ACCESS_WITH_ECU_ONLY XCP_WRITE_ACCESS_NOT_ALLOWED /end PAGE
   /end SEGMENT
  /end IF_DATA
 /end MEMORY_SEGMENT
 /begin MEMORY_SEGMENT dspr0 "RAM_Core0" CALIBRATION_VARIABLES RAM INTERN 0x70000000 0x38000 -1 -1 -1 -1 -1 /end MEMORY_SEGMENT
 /begin MEMORY_SEGMENT dspr1 "RAM_Core1" CALIBRATION_VARIABLES RAM INTERN 0x60000000 0x38000 -1 -1 -1 -1 -1 /end MEMORY_SEGMENT
 /begin MEMORY_SEGMENT dspr2 "RAM_Core2" CALIBRATION_VARIABLES RAM INTERN 0x50000000 0x17000 -1 -1 -1 -1 -1 /end MEMORY_SEGMENT
 /begin MEMORY_SEGMENT dspr3 "RAM_Core3" CALIBRATION_VARIABLES RAM INTERN 0x40000000 0x17000 -1 -1 -1 -1 -1 /end MEMORY_SEGMENT
/end MOD_PAR
/begin MOD_COMMON "" ALIGNMENT_BYTE 1 ALIGNMENT_WORD 2 ALIGNMENT_LONG 4 ALIGNMENT_FLOAT16_IEEE 2 ALIGNMENT_FLOAT32_IEEE 4 ALIGNMENT_FLOAT64_IEEE 8 ALIGNMENT_INT64 8 /end MOD_COMMON
/begin AXIS_PTS ca_Colu_xxTempMax "Curve axis for the target oil coolant volume flow depend on maximum temperature." 0xb05368F0 NO_INPUT_QUANTITY typF32_axis 0 cv_degC_float 4 -3.4e+38 3.4e+38 /end AXIS_PTS
/begin AXIS_PTS ca_Colu_Emtest "Curve axis for the target oil coolant volume flow depend on Em1 power losses." 0xb05368DC NO_INPUT_QUANTITY typF32_axis 0 cv_W_float 5 -3.4e+38 3.4e+38 /end AXIS_PTS
/begin CHARACTERISTIC TestCalib1 "-" VALUE 0xb050C084 recVAL_UBYTE 0 COMPU_METHOD_FSW_XX 0 255 /end CHARACTERISTIC
/begin CHARACTERISTIC TestCalib2 "-" VALUE 0xb050C098 recVAL_UBYTE 0 COMPU_METHOD_FSW_XX 0 255 /end CHARACTERISTIC
/begin CHARACTERISTIC TestCalib3 "-" VALUE 0xb050C0AC recVAL_UBYTE 0 COMPU_METHOD_FSW_XX 0 255 /end CHARACTERISTIC
/begin COMPU_METHOD cv_0_1A_A "" RAT_FUNC "%5.0" "A" COEFFS 0 10 0 0 0 1 /end COMPU_METHOD
/begin COMPU_METHOD cv_0_1W_W "" RAT_FUNC "%5.0" "W" COEFFS 0 10 0 0 0 1 /end COMPU_METHOD
/begin COMPU_VTAB enumTab_cv_Enum_SelInpPwr "" TAB_VERB 3 0 "DERAT_SEL_INP_PWR_REQ" 1 "DERAT_SEL_INP_PWR_ACT" 2 "DERAT_SEL_INP_PWR_MAX_REQ_ACT" /end COMPU_VTAB
/begin COMPU_VTAB enumTab_cv_Enum_TqCpbySelTqFilMode "" TAB_VERB 3 0 "DERAT_SEL_FIL_NONE" 1 "DERAT_SEL_FIL_MOVING_AVERAGE" 2 "DERAT_SEL_FIL_GRADIENT" /end COMPU_VTAB
/begin MEASUREMENT Testvar1 "Number of 10 ms interrupts since startup. Wraps around when UI16 maximum is reached." UWORD cv_counter 1 1 0 65535 ECU_ADDRESS 0x4000D944 /end MEASUREMENT
/begin MEASUREMENT Testvar12 "Testvar12" UWORD cv_counter 1 1 0 65535 ECU_ADDRESS 0x4000D90C /end MEASUREMENT
/begin GROUP WDGM "" /begin REF_MEASUREMENT WdgM_EB_GlobalStatus Testvar12 /end REF_MEASUREMENT /end GROUP
/begin FUNCTION status_handling_rps1 "" /begin LOC_MEASUREMENT s_Srps_StatusSignalRps1 /end LOC_MEASUREMENT /end FUNCTION
/begin FUNCTION status_handling_rps2 "" /begin LOC_MEASUREMENT s_Srps_StatusSignalRps2 /end LOC_MEASUREMENT /end FUNCTION
/begin RECORD_LAYOUT typUI8 FNC_VALUES 1 UBYTE COLUMN_DIR DIRECT /end RECORD_LAYOUT
/begin RECORD_LAYOUT typSI8_2D_Map FNC_VALUES 5 SBYTE ROW_DIR PLONG AXIS_PTS_X 3 SBYTE INDEX_INCR PLONG AXIS_PTS_Y 4 SBYTE INDEX_INCR PLONG NO_AXIS_PTS_X 1 SWORD NO_AXIS_PTS_Y 2 SWORD /end RECORD_LAYOUT
/end MODULE
/end PROJECT
